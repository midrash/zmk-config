## boards/shields/corne/Kconfig.defconfig
```kconfig
if SHIELD_CORNE_DONGLE

config ZMK_KEYBOARD_NAME
    default "Corne"

config ZMK_SPLIT_ROLE_CENTRAL
    default n

config ZMK_USB 
    default y

endif # SHIELD_CORNE_DONGLE

if SHIELD_CORNE_DONGL || SHIELD_CORNE_LEFT || SHIELD_CORNE_RIGHT

config ZMK_SPLIT
    default y

config ZMK_BLE
    default y

endif # SHIELD_CORNE_DONGL || SHIELD_CORNE_LEFT || SHIELD_CORNE_RIGHT
```

## config/west.yml
```yaml
manifest:
  remotes:
    # - name: zmkfirmware
    #   url-base: https://github.com/zmkfirmware
    # - name: urob
    #   url-base: https://github.com/urob
    - name: petejohanson
      url-base: https://github.com/petejohanson
    # - name: englmaxi
    #   url-base: https://github.com/englmaxi
  projects:
    # - name: zmk
    #   remote: zmkfirmware
    #   revision: main
    #   import: app/west.yml
    # - name: zmk
    #   remote: urob
    #   revision: main
    #   import: app/west.yml
    - name: zmk
      remote: petejohanson
      revision: feat/pointers-move-scroll
      import: app/west.yml
    
    # modules
    # - name: zmk-dongle-display
    #   remote: englmaxi
    #   revision: main
  self:
    path: config
```
